## drivers/sharp/Kconfig
```kconfig
#
# SHARP configuration
#

menu "SHARP Device Drivers"

source "drivers/sharp/mfc/Kconfig"

source "drivers/sharp/wifi/Kconfig"

source "drivers/sharp/irda/Kconfig"

source "drivers/sharp/presenter/Kconfig"

endmenu
```

## drivers/sharp/irda/Kconfig
```kconfig
menu "SIR/FIR IrDA/IrSimple driver"

comment "SHARP Infrared device drivers"

config SHIRDA
	bool "SHARP LR388G7 IrDA SIR/FIR driver"
	default y

endmenu
```

## drivers/sharp/mfc/Kconfig
```kconfig
#
# FeliCa device configuration
#

menu "FeliCa driver"

comment "SHARP FeliCa device drivers"

config SHFELICA
	bool "FeliCa device drivers"
	depends on SERIAL_MSM && I2C && MSM_DEBUG_UART_NONE
	default y
	help
	  Enable FeliCa driver.

endmenu
```

## drivers/sharp/presenter/Kconfig
```kconfig
#
# Presenter device configuration
#

menu "Presenter driver"

comment "SHARP Presenter device drivers"

config SHPRESENTER
	bool "Presenter device drivers"
	depends on SPHINX_SECURITY
	default y
	help
	  Enable Presenter driver.

endmenu
```

## drivers/sharp/wifi/Kconfig
```kconfig
# drivers/sharp/wifi/Kconfig

menu "Wi-Fi Configuration"

config BWPM
	bool "BT/WLAN Power Management Support"
	default y
	help
	  Power management implementation for BT, FM, and WLAN Functionality.

config CSR_SYNERGY_WIFI
	bool "CSR Synergy Wifi Support"
	depends on BWPM
	default y
	help
	  Enable CSR WiFi device driver.

endmenu
```

## security/sphinx/Kconfig
```kconfig
config SPHINX_SECURITY
	bool "Sphinx Security Module Support"
	select SHPRESENTER
	default y
	help
	  Enable Sphinx Security Modules.
```
